## meta-mypi/conf/distro/pi-mypi.conf
```bitbake
require conf/distro/poky.conf

DISTRO = "pi-mypi"
DISTRO_NAME = "pi-mypi"
DISTRO_VERSION = "1.0"

BB_NUMBER_THREADS = "16"
PARALLEL_MAKE = "-j16"
```

## meta-mypi/conf/layer.conf
```bitbake
# We have a conf and classes directory, add to BBPATH
BBPATH .= ":${LAYERDIR}"

# We have recipes-* directories, add to BBFILES
BBFILES += "${LAYERDIR}/recipes-*/*/*.bb \
            ${LAYERDIR}/recipes-*/*/*.bbappend"

BBFILE_COLLECTIONS += "meta-mypi"
BBFILE_PATTERN_meta-mypi = "^${LAYERDIR}/"
BBFILE_PRIORITY_meta-mypi = "6"

LAYERDEPENDS_meta-mypi = "core"
LAYERSERIES_COMPAT_meta-mypi = "kirkstone"
```
